## kksdcmd/Config.in
```kconfig
# kksdcmd configuration
if PACKAGE_kksdcmd

config KKSDCMD_EMBEDDED_LIBMODBUS
	bool "embed libmodbus statically"
	default y
  help
    Enabling this embeds libmodbus by building it from the enhanced version
    in p44utils, rather than using the standard libmodbus.
    Note: this is required until the additions to libmodbus are accepted upstream.

config KKSDCMD_UBUS
	bool "Include ubus Support"
	default y
  help
    Enabling this includes support for ubus API

endif
```

## p44-xx-diy-config/Config.in
```kconfig
# p44-xx-diy-config configuration
if PACKAGE_p44-xx-diy-config

config P44_FEED_NAME
  string
  prompt "plan44 feed name"
  default "testing"
  help
    Specify plan44 feed name

endif
```

## p44featured/Config.in
```kconfig
# p44featured configuration
if PACKAGE_p44featured

config P44FEATURED_UBUS
	bool "Include ubus Support"
	default y
  help
    Enabling this includes support for ubus API

config P44FEATURED_EV
	bool "Base Mainloop on libev"
	default n
  help
    Enabling this makes the mainloop use libev for I/O polling which allows
    using features that are libev-based such as UWSC websockets.
    If enabled, p44featured depends on libev

config P44FEATURED_UWSC
  depends on P44FEATURED_EV
	bool "Include uwsc (websocket) support"
	default n
  help
    Enabling this includes support for websocket clients in p44script
    If enabled, p44featured depends on package libuwsc

config P44FEATURED_RRDB
	bool "Include rrd(tool) support for logging sensor data"
	default n
  help
    Enabling this includes support for librrd (round robin database, rrdtool).
    If enabled, p44featured depends on package librrd1

config P44FEATURED_PNG
	bool "Include PNG support for advanced LED chain light effects"
	default n
  help
    Enabling this includes support for displaying PNG images in LED matrix lights.
    If enabled, p44featured depends on package libpng

config P44FEATURED_RPIWS281X
  depends on TARGET_brcm2708_bcm2708_DEVICE_rpi || TARGET_brcm2708_bcm2709_DEVICE_rpi-2 || TARGET_brcm2708_bcm2710_DEVICE_rpi-3
	bool "Include support for WS281x LED-chains"
	default n
	help
    Enabling this makes ledchain support use RaspberryPi-specific
    hardware (instead relying on a kernel driver like p44-ledchain)

endif
```

## pixelboard-config/Config.in
```kconfig
# p44dsb-config configuration
menu "p44dsb configuration"
  depends on PACKAGE_p44dsb-config

  config P44_PRODUCT_IDENTIFIER
    string
    prompt "plan44 product identifier"
    default "unknown"
    help
      Specify plan44 product identifier (used to choose appropriate runtime config)

  config P44_FEED_NAME
    string
    prompt "plan44 feed name"
    default "testing"
    help
      Specify plan44 feed name

  config P44_PRODUCER_IDENTIFIER
    string
    prompt "producer identifier"
    default "plan44"
    help
      Specify producer name to be embedded into image


endmenu
```

## vdcd/Config.in
```kconfig
# vdcd configuration
if PACKAGE_vdcd

config VDCD_OLA
	bool "Include OLA support"
	default n
  help
    Enabling this includes support for OLA (Open Lighting Architecture).
    If enabled, vdcd depends on package ola

config VDCD_UBUS
	bool "Include ubus support"
	default n
  help
    Enabling this includes support for ubus API

config VDCD_I2C
	bool "Include i2c support"
	default y
  help
    Enabling this includes support for I2C based devices, requiring libi2c

config VDCD_EV
	bool "Base Mainloop on libev"
	default n
  help
    Enabling this makes the mainloop use libev for I/O polling which allows
    using features that are libev-based such as UWSC websockets.
    If enabled, vdcd depends on libev

config VDCD_UWSC
  depends on VDCD_EV
	bool "Include uwsc (websocket) support"
	default n
  help
    Enabling this includes support for websocket clients in p44script
    If enabled, vdcd depends on package libuwsc

config VDCD_RRDB
	bool "Include rrd(tool) support for logging sensor data"
	default n
  help
    Enabling this includes support for librrd (round robin database, rrdtool).
    If enabled, vdcd depends on package librrd1

config VDCD_PNG
	bool "Include PNG support for advanced LED chain light effects"
	default n
  help
    Enabling this includes support for displaying PNG images in LED matrix lights.
    If enabled, vdcd depends on package libpng

config VDCD_RPIWS281X
  depends on TARGET_bcm27xx_bcm2708_DEVICE_rpi || TARGET_bcm27xx_bcm2709_DEVICE_rpi-2 || TARGET_bcm27xx_bcm2710_DEVICE_rpi-3
	bool "Include support for WS281x LED-chains"
	default n
	help
    Enabling this makes ledchain support use RaspberryPi-specific
    hardware (instead relying on a kernel driver like p44-ledchain)

config VDCD_P44FEATURES
	bool "Include support for p44features (specific usecase drivers)"
	default n
  help
    Enabling this includes support for p44features, a set of drivers for
    very specific peripheral hardware and use cases for exhibitions & art project.

config VDCD_MODBUS
	bool "Include modbus support"
	default n
  help
    Enabling this includes support for modbus

config VDCD_EMBEDDED_LIBMODBUS
  depends on VDCD_MODBUS
	bool "embed libmodbus statically"
	default y
  help
    Enabling this embeds libmodbus by building it from the enhanced version
    in p44utils, rather than using the standard libmodbus.
    Note: this is required until the additions to libmodbus are accepted upstream.

endif
```
